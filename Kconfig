## Kconfig
```kconfig
menu "espmirror"

    config ESPMIRROR_USB_NETWORK
        bool "USB network and serial port over TinyUSB"
        depends on SOC_USB_OTG_SUPPORTED
        select ESPMIRROR_TCP
        default n
        help
            The native USB port becomes a TinyUSB device with two interfaces,
            both carrying the mirror: a serial port (CDC-ACM) and a network
            (CDC-NCM) where the board is 192.168.N.1 and hands the computer an
            address with no route. ESP-IDF's DHCP server still names the board
            as the DNS server; the board answers no DNS queries. It selects
            TCP, so the unauthenticated port also listens on any other network
            the application brings up, Wi-Fi included.
            Needs espressif/esp_tinyusb 2.4.0 or later in the application with
            CONFIG_TINYUSB_CDC_ENABLED, CONFIG_TINYUSB_NET_MODE_NCM, a product
            string containing "espmirror" (the viewer looks for it), an empty
            serial string (it becomes the MAC) and CONFIG_MDNS_MAX_INTERFACES
            raised to 4; examples/virtual/sdkconfig.usbnet has them all. The
            USB Serial/JTAG console is gone while it runs: put the console on
            UART and flash with BOOT held.

    config ESPMIRROR_USB_NETWORK_SUBNET
        int "Third byte of the USB network, 192.168.N.0/24"
        depends on ESPMIRROR_USB_NETWORK
        range 0 255
        default 7
        help
            Two boards on one computer need different values.

    config ESPMIRROR_USB
        bool "USB Serial/JTAG mirror"
        depends on SOC_USB_SERIAL_JTAG_SUPPORTED && !ESPMIRROR_USB_NETWORK
        depends on !ESP_CONSOLE_UART_DEFAULT && !ESP_CONSOLE_UART_CUSTOM && !ESP_CONSOLE_USB_CDC
        default y
        help
            Native USB Serial/JTAG only. Select the USB Serial/JTAG console
            or no console. UART and USB OTG CDC consoles are not supported.

    config ESPMIRROR_USB_AUTO
        bool "Install the USB driver and read mirror commands"
        depends on ESPMIRROR_USB
        default y
        help
            Disable when the application reads the console itself. Set
            external_console in the config if it also installs the driver.

    config ESPMIRROR_TCP
        bool "TCP and mDNS mirror (no authentication)"
        default n
        help
            Binds to every address, so it listens on each network the
            application brings up, such as Wi-Fi or the USB network. The
            application starts Wi-Fi itself.

    config ESPMIRROR_DELTA
        bool "Try XOR delta rectangles"
        default n

    config ESPMIRROR_QOI
        bool "Try QOI rectangles"
        default n


    config ESPMIRROR_PORT
        int "TCP port the viewer connects to"
        range 1 65535
        default 7331

    config ESPMIRROR_FRAME_MS
        int "Shortest interval between two frames, ms"
        range 10 1000
        default 40
        help
            The mirror task collects the changed rectangles and sends them at most
            this often. 40 ms is 25 frames a second at best; a slower pace costs
            less CPU and Wi-Fi.

    config ESPMIRROR_AUDIO
        bool "Audio: let the viewer hear the microphone or the speaker"
        default y
        help
            espmirror_audio_capture() and espmirror_audio_playback() copy what the
            board hears and plays into a ring the viewer can listen to, and the
            viewer may send its own microphone back through the on_talk callbacks.
            Off, those calls compile to nothing.
            The port has no authentication: with this on, anyone on the network who
            can reach it hears the microphone and may talk into the speaker. Keep it
            off in an image that leaves the bench.

    config ESPMIRROR_AUDIO_RING_KB
        int "Audio ring, KB (a power of two)"
        depends on ESPMIRROR_AUDIO
        range 8 256
        default 16
        help
            16 KB holds half a second of 16 kHz mono PCM16; the viewer catches up
            from the newest half of the ring when it falls behind. 8, 16, 32, 64,
            128 or 256: the build checks.

    config ESPMIRROR_MSG_KB
        int "Frame message buffer, KB"
        range 8 64
        default 32
        help
            One frame goes out as one message; what does not fit waits for the
            next. 32 KB carries a whole 128 x 128 screen raw. Smaller saves RAM
            on a chip without PSRAM and costs a few more messages per big change.

    config ESPMIRROR_TASK_STACK
        int "Mirror task stack, bytes"
        range 3072 16384
        default 4096

    config ESPMIRROR_TASK_PRIORITY
        int "Mirror task priority"
        range 1 24
        default 3

    config ESPMIRROR_TASK_CORE
        int "Mirror task core (-1 any)"
        range -1 1 if !FREERTOS_UNICORE
        range -1 0 if FREERTOS_UNICORE
        default -1

    config ESPMIRROR_PREFER_PSRAM
        bool "Keep the screen copy and the buffers in PSRAM when there is some"
        default y
        help
            The screen copy is width x height x 2 bytes (150 KB for 320 x 240); the
            message buffer 32 KB; the audio ring as configured. With this on they
            go to PSRAM when the chip has it and to internal RAM otherwise.

endmenu
```

## examples/basic/main/Kconfig.projbuild
```kconfig
menu "espmirror example"

    config EXAMPLE_MIRROR_NAME
        string "The board's name for the viewer"
        default "espmirror basic"
        help
            The viewer draws a device it knows ("Waveshare 2.16", "Waveshare 1.54G",
            "Waveshare 1.75C", "AIPI Lite"); any other name gets a plain frame.

    config EXAMPLE_MIRROR_WIDTH
        int "Screen width, pixels"
        default 240

    config EXAMPLE_MIRROR_HEIGHT
        int "Screen height, pixels"
        default 240

    config EXAMPLE_MIRROR_PPI
        int "Pixels per inch (for the viewer's real-size mode)"
        default 200

endmenu
```

## examples/lvgl/main/Kconfig.projbuild
```kconfig
menu "espmirror example"

    choice EXAMPLE_BOARD
        prompt "The board"
        default EXAMPLE_BOARD_NONE
        help
            A board the example knows drives its own panel as well as the mirror;
            any other board shows the user interface on the mirror only.

        config EXAMPLE_BOARD_NONE
            bool "Any devkit: the mirror is the display"

        config EXAMPLE_BOARD_AIPI_LITE
            bool "XOrigin AIPI Lite (ESP32-S3, 128 x 128 ST7789)"

        config EXAMPLE_BOARD_WAVESHARE_216
            bool "Waveshare AMOLED 2.16 (ESP32-S3, 480 x 480 CO5300)"
            depends on IDF_TARGET_ESP32S3

        config EXAMPLE_BOARD_WAVESHARE_175C
            bool "Waveshare 1.75C (ESP32S3, 466 x 466 CO5300)"
            depends on IDF_TARGET_ESP32S3
    endchoice

    config EXAMPLE_BOARD_ID
        string
        default "waveshare_216" if EXAMPLE_BOARD_WAVESHARE_216
        default "waveshare_175c" if EXAMPLE_BOARD_WAVESHARE_175C
        default "none"

    config EXAMPLE_MIRROR_NAME
        string "The board's name for the viewer"
        default "AIPI Lite" if EXAMPLE_BOARD_AIPI_LITE
        default "Waveshare 2.16" if EXAMPLE_BOARD_WAVESHARE_216
        default "Waveshare 1.75C" if EXAMPLE_BOARD_WAVESHARE_175C
        default "espmirror lvgl"
        help
            The viewer draws a device it knows ("Waveshare 2.16", "Waveshare 1.54G",
            "Waveshare 1.75C", "AIPI Lite"); any other name gets a plain frame.

    config EXAMPLE_MIRROR_WIDTH
        int "Screen width, pixels" if EXAMPLE_BOARD_NONE
        default 466 if EXAMPLE_BOARD_WAVESHARE_175C
        default 480 if EXAMPLE_BOARD_WAVESHARE_216
        default 128 if EXAMPLE_BOARD_AIPI_LITE
        default 240

    config EXAMPLE_MIRROR_HEIGHT
        int "Screen height, pixels" if EXAMPLE_BOARD_NONE
        default 466 if EXAMPLE_BOARD_WAVESHARE_175C
        default 480 if EXAMPLE_BOARD_WAVESHARE_216
        default 128 if EXAMPLE_BOARD_AIPI_LITE
        default 240

    config EXAMPLE_MIRROR_PPI
        int "Pixels per inch (for the viewer's real-size mode)"
        default 377 if EXAMPLE_BOARD_WAVESHARE_175C
        default 126 if EXAMPLE_BOARD_AIPI_LITE
        default 314 if EXAMPLE_BOARD_WAVESHARE_216
        default 200

    config EXAMPLE_MIRROR_ROUND
        bool
        default y if EXAMPLE_BOARD_WAVESHARE_175C
        default n

endmenu
```

## examples/mosaico/main/Kconfig.projbuild
```kconfig
menu "Mosaico example"
    config MOSAICO_PANEL
        bool "Drive the physical panel, touch, FN and BOOT"
        default n
        help
            CO5300 QSPI panel and CST9220 touch. Detect the board revision
            from eFuse before selecting pins. POWER in the viewer toggles
            the display; the physical ON/OFF switch is not a GPIO input.
endmenu
```

## examples/mosaico/sdkconfig.defaults
```kconfig
CONFIG_IDF_TARGET="esp32s31"
CONFIG_IDF_EXPERIMENTAL_FEATURES=y
CONFIG_ESP_DEFAULT_CPU_FREQ_MHZ_320=y
CONFIG_ESPTOOLPY_FLASHMODE_QIO=y
CONFIG_ESPTOOLPY_FLASHSIZE_16MB=y
CONFIG_PARTITION_TABLE_CUSTOM=y
CONFIG_PARTITION_TABLE_CUSTOM_FILENAME="partitions.csv"
CONFIG_PARTITION_TABLE_OFFSET=0x8000
CONFIG_BOOTLOADER_LOG_LEVEL_ERROR=y
CONFIG_SPIRAM=y
CONFIG_SPIRAM_SPEED_250M=y
CONFIG_SPIRAM_XIP_FROM_PSRAM=y
CONFIG_SPIRAM_MEMTEST=n
CONFIG_ESP_CONSOLE_UART_DEFAULT=y
CONFIG_ESP_CONSOLE_SECONDARY_NONE=y
CONFIG_ESPMIRROR_IRIS=y
CONFIG_ESPMIRROR_USB=n
CONFIG_ESPMIRROR_USB_NETWORK=n
CONFIG_ESPMIRROR_TCP=n
CONFIG_ESPMIRROR_AUDIO=n
CONFIG_ESPMIRROR_MSG_KB=8
CONFIG_ESPMIRROR_PREFER_PSRAM=y
CONFIG_ESP_IRIS_ENABLE=y
CONFIG_ESP_IRIS_FIRMWARE_ROLE=1
CONFIG_ESP_IRIS_PRODUCT_CONTRACT="esp-mosaico/v2"
CONFIG_ESP_IRIS_BOARD_ID="esp-mosaico"
CONFIG_ESP_IRIS_LAYOUT_ID="mosaico-retained-test-2m-v2"
CONFIG_ESP_IRIS_RECOVERY_ABI=2
CONFIG_ESP_IRIS_OTA_DEFAULT_VIA_RECOVERY=y
CONFIG_ESP_IRIS_SYSTEM_INVENTORY=y
CONFIG_ESP_IRIS_OTA=n
CONFIG_ESP_IRIS_NVS_PARTITION_NAME="sysmeta"
CONFIG_ESP_IRIS_TRANSPORT_USB=y
CONFIG_ESP_IRIS_TRANSPORT_TCP=n
CONFIG_ESP_IRIS_USB_PRODUCT="ESP-Iris espmirror"
CONFIG_TINYUSB_CDC_COUNT=2
CONFIG_ESP_IRIS_RPC_BODY_BYTES=2048
CONFIG_ESP_IRIS_MEDIA_LATEST_BYTES=3840
CONFIG_ESP_IRIS_MEDIA_BUFFER_PSRAM=y
CONFIG_ESP_COREDUMP_ENABLE_TO_FLASH=y
CONFIG_APP_RETRIEVE_LEN_ELF_SHA=64
```

## examples/virtual/main/Kconfig.projbuild
```kconfig
# Copyright (c) 2026 Maksim Nagaev
# SPDX-License-Identifier: Apache-2.0
menu "Virtual display"
    depends on IDF_TARGET_ESP32S3

    choice VIRTUAL_DEVICE
        prompt "Device"
        default VIRTUAL_DEVICE_CUSTOM
        help
            A device the viewer has a profile for: its screen's size and shape,
            touch or not, its keys, and a name that makes the viewer draw its
            body at its real size. Screens bigger than 240 x 240 need PSRAM
            (sdkconfig.psram).

        config VIRTUAL_DEVICE_CUSTOM
            bool "Your own: width, height, shape, diagonal and name below"
        config VIRTUAL_DEVICE_WAVESHARE_216
            bool "Waveshare ESP32-S3-Touch-AMOLED-2.16 (480 x 480)"
        config VIRTUAL_DEVICE_WAVESHARE_154G
            bool "Waveshare ESP32-S3 e-Paper 1.54G (200 x 200, keys only)"
        config VIRTUAL_DEVICE_WAVESHARE_175C
            bool "Waveshare ESP32-S3-Touch-AMOLED-1.75C (466 x 466, round)"
        config VIRTUAL_DEVICE_WAVESHARE_349
            bool "Waveshare ESP32-S3-Touch-LCD-3.49 (172 x 640)"
        config VIRTUAL_DEVICE_WAVESHARE_P4_35
            bool "Waveshare ESP32-P4-WIFI6-Touch-LCD-3.5 (480 x 320)"
        config VIRTUAL_DEVICE_AIPI_LITE
            bool "XOrigin AIPI Lite (128 x 128, keys only)"
        config VIRTUAL_DEVICE_ESP_MOSAICO
            bool "Espressif ESP-Mosaico (480 x 480)"
        config VIRTUAL_DEVICE_SENSECAP_WATCHER
            bool "Seeed SenseCAP Watcher (412 x 412, round)"
    endchoice

    config VIRTUAL_WIDTH
        int "Width in pixels"
        depends on VIRTUAL_DEVICE_CUSTOM
        range 128 640
        default 240

    config VIRTUAL_HEIGHT
        int "Height in pixels"
        depends on VIRTUAL_DEVICE_CUSTOM
        range 128 640
        default 240

    config VIRTUAL_ROUND
        bool "Round screen"
        depends on VIRTUAL_DEVICE_CUSTOM
        default n

    config VIRTUAL_DIAGONAL_100
        int "Diagonal in hundredths of an inch (200 = 2.00 inches)"
        depends on VIRTUAL_DEVICE_CUSTOM
        range 0 2000
        default 200

    config VIRTUAL_NAME
        string "Name shown in the viewer"
        depends on VIRTUAL_DEVICE_CUSTOM
        default "Virtual ESP32-S3"

    config VIRTUAL_BOOT_GPIO
        int "BOOT GPIO, active low (-1 disables)"
        range -1 48
        default 0
        help
            GPIO0 on the XIAO ESP32S3 and ESP32-S3-DevKitC-1.
            Release BOOT while resetting to run the application.

    config VIRTUAL_WIFI
        bool "Join a Wi-Fi network; the mirror listens on TCP too"
        depends on SPIRAM
        select ESPMIRROR_TCP
        default n
        help
            Needs PSRAM (Component config > ESP PSRAM, octal on the XIAO
            ESP32S3 and the DevKitC-1 N8R8). Without it the 240 x 240 mirror
            leaves Wi-Fi too little internal RAM to start.

    config VIRTUAL_WIFI_SSID
        string "Wi-Fi network"
        depends on VIRTUAL_WIFI

    config VIRTUAL_WIFI_PASSWORD
        string "Wi-Fi password"
        depends on VIRTUAL_WIFI
endmenu
```

## examples/virtual/sdkconfig.defaults
```kconfig
# Copyright (c) 2026 Maksim Nagaev
# SPDX-License-Identifier: Apache-2.0
CONFIG_IDF_TARGET="esp32s3"
CONFIG_ESP_CONSOLE_USB_SERIAL_JTAG=y
CONFIG_ESPMIRROR_USB=y
CONFIG_ESPMIRROR_USB_AUTO=y
CONFIG_ESPMIRROR_TCP=n
CONFIG_ESPMIRROR_AUDIO=n
CONFIG_ESPMIRROR_DELTA=n
CONFIG_ESPMIRROR_QOI=n
CONFIG_ESPMIRROR_PREFER_PSRAM=y
CONFIG_LV_COLOR_DEPTH_16=y
CONFIG_LV_USE_LOG=n
CONFIG_LV_FONT_MONTSERRAT_14=y
CONFIG_LV_THEME_DEFAULT_DARK=y
CONFIG_ESP_MAIN_TASK_STACK_SIZE=8192
CONFIG_ESPTOOLPY_FLASHSIZE_4MB=y
CONFIG_PARTITION_TABLE_SINGLE_APP_LARGE=y
```
